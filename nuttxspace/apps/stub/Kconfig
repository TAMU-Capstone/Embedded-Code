## nuttxspace/apps/stub/Kconfig
```kconfig
#
# For a description of the syntax of this configuration file,
# see the file kconfig-language.txt in the NuttX tools repository.
#
menu "Stub Application"
config STUB
	tristate "\"stub\" example"
	default n
	---help---
		Enable the \"stub\" example

if STUB

config STUB_PROGNAME
	string "Program name"
	default "stub"
	---help---
		This is the name of the program that will be used when the NSH ELF
		program is installed.

config STUB_PRIORITY
	int "stub task priority"
	default 100

config STUB_STACKSIZE
	int "stub stack size"
	default DEFAULT_TASK_STACKSIZE

endif
endmenu # Stub Framework
```

## nuttxspace/apps/testingApp/Kconfig
```kconfig
#
# For a description of the syntax of this configuration file,
# see the file kconfig-language.txt in the NuttX tools repository.
#
menu "Testing Application"
config TEST
	tristate "\"testingApp\" example"
	default n
	---help---
		Enable the \"testingApp\" example

if TEST

config TEST_PROGNAME
	string "Program name"
	default "testingApp"
	---help---
		This is the name of the program that will be used when the NSH ELF
		program is installed.

config TEST_PRIORITY
	int "testingApp task priority"
	default 100

config TEST_STACKSIZE
	int "testingApp stack size"
	default DEFAULT_TASK_STACKSIZE

endif
endmenu # testingApp Framework
```

## nuttxspace/apps/testingAutoleds/Kconfig
```kconfig
#
# For a description of the syntax of this configuration file,
# see the file kconfig-language.txt in the NuttX tools repository.
#
menu "Testing Autoleds"
config AUTOLEDS
	tristate "\"testingAutoleds\" example"
	default n
	---help---
		Enable the \"testingAutoleds\" example

if AUTOLEDS

config AUTOLEDS_PROGNAME
	string "Program name"
	default "testingAutoleds"
	---help---
		This is the name of the program that will be used when the NSH ELF
		program is installed.

config AUTOLEDS_PRIORITY
	int "testingAutoleds task priority"
	default 100

config AUTOLEDS_STACKSIZE
	int "testingAutoleds stack size"
	default DEFAULT_TASK_STACKSIZE

endif
endmenu # testingAutoleds Framework
```

## nuttxspace/apps/testingButtons/Kconfig
```kconfig
#
# For a description of the syntax of this configuration file,
# see the file kconfig-language.txt in the NuttX tools repository.
#
menu "Testing Buttons"
config BUTTONS
	tristate "\"testingButtons\" example"
	default n
	---help---
		Enable the \"testingButtons\" example

if BUTTONS

config BUTTONS_PROGNAME
	string "Program name"
	default "testingButtons"
	---help---
		This is the name of the program that will be used when the NSH ELF
		program is installed.

config BUTTONS_PRIORITY
	int "testingButtons task priority"
	default 100

config BUTTONS_STACKSIZE
	int "testingButtons stack size"
	default DEFAULT_TASK_STACKSIZE


endif
endmenu # testingButtons Framework
```

## nuttxspace/apps/testingGPIO/Kconfig
```kconfig
#
# For a description of the syntax of this configuration file,
# see the file kconfig-language.txt in the NuttX tools repository.
#
menu "Testing GPIO"
config GPIO
	tristate "\"testingGPIO\" example"
	default n
	---help---
		Enable the \"testingGPIO\" example

if GPIO

config GPIO_PROGNAME
	string "Program name"
	default "testingGPIO"
	---help---
		This is the name of the program that will be used when the NSH ELF
		program is installed.

config GPIO_PRIORITY
	int "testingGPIO task priority"
	default 100

config GPIO_STACKSIZE
	int "testingGPIO stack size"
	default DEFAULT_TASK_STACKSIZE

endif
endmenu # testingGPIO Framework
```

## nuttxspace/apps/testingGpio/Kconfig
```kconfig
#
# For a description of the syntax of this configuration file,
# see the file kconfig-language.txt in the NuttX tools repository.
#
menu "GPIO_TEST Application"
config GPIO_TEST
	tristate "\"GPIO_TEST\" example"
	default n
	---help---
		Enable the \"GPIO_TEST\" example

if GPIO_TEST

config GPIO_TEST_PROGNAME
	string "Program name"
	default "GPIO_TEST"
	---help---
		This is the name of the program that will be used when the NSH ELF
		program is installed.

config GPIO_TEST_PRIORITY
	int "GPIO_TEST task priority"
	default 100

config GPIO_TEST_STACKSIZE
	int "GPIO_TEST stack size"
	default DEFAULT_TASK_STACKSIZE

endif
endmenu # GPIO_TEST Framework
```

## nuttxspace/apps/testingLeds/Kconfig
```kconfig
#
# For a description of the syntax of this configuration file,
# see the file kconfig-language.txt in the NuttX tools repository.
#
menu "Testing Leds"
config TEST
	tristate "\"testingLeds\" example"
	default n
	---help---
		Enable the \"testingLeds\" example

if TEST

config TEST_PROGNAME
	string "Program name"
	default "testingLeds"
	---help---
		This is the name of the program that will be used when the NSH ELF
		program is installed.

config TEST_PRIORITY
	int "testingLeds task priority"
	default 100

config TEST_STACKSIZE
	int "testingLeds stack size"
	default DEFAULT_TASK_STACKSIZE

endif
endmenu # testingLeds Framework
```

## nuttxspace/apps/testingSpi/Kconfig
```kconfig
#
# For a description of the syntax of this configuration file,
# see the file kconfig-language.txt in the NuttX tools repository.
#
menu "Testing SPI"
config SPItest
	tristate "\"testingSpi\" example"
	default n
	---help---
		Enable the \"testingSpi\" example

if SPItest

config SPI_PROGNAME
	string "Program name"
	default "testingSpi"
	---help---
		This is the name of the program that will be used when the NSH ELF
		program is installed.

config SPI_PRIORITY
	int "testingSpi task priority"
	default 100

config SPI_STACKSIZE
	int "testingSpi stack size"
	default DEFAULT_TASK_STACKSIZE


endif
endmenu # testingSpi Framework
```

## nuttxspace/apps/testingUserleds/Kconfig
```kconfig
#
# For a description of the syntax of this configuration file,
# see the file kconfig-language.txt in the NuttX tools repository.
#
menu "Testing Userleds"
config USERLEDS
	tristate "\"testingUserleds\" example"
	default n
	---help---
		Enable the \"testingUserleds\" example

if USERLEDS

config USERLEDS_PROGNAME
	string "Program name"
	default "testingUserleds"
	---help---
		This is the name of the program that will be used when the NSH ELF
		program is installed.

config USERLEDS_PRIORITY
	int "testingUserleds task priority"
	default 100

config USERLEDS_STACKSIZE
	int "testingUserleds stack size"
	default DEFAULT_TASK_STACKSIZE

endif
endmenu # testingUserleds Framework
```
